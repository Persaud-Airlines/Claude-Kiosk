## firmware/main/Kconfig.projbuild
```kconfig
menu "DE-TECH-TIVE Kiosk"

    config DT_DEFAULT_HOST_URL
        string "Default Master/Host server URL"
        default "https://kiosk.example-school.org"
        help
            Pre-filled host URL in the setup wizard (editable via the gear icon on the Wi-Fi step).

    choice DT_CAMERA_SOURCE
        prompt "Camera provider"
        default DT_CAMERA_UVC
        config DT_CAMERA_UVC
            bool "USB UVC webcam (OTG port)"
        config DT_CAMERA_MOCK
            bool "Mock frame injector (bench testing, no camera)"
    endchoice

    config DT_UVC_WIDTH
        int "UVC frame width"
        default 640
    config DT_UVC_HEIGHT
        int "UVC frame height"
        default 480
    config DT_UVC_FPS
        int "UVC frame rate"
        default 15

    config DT_USB_SEL_LEVEL
        int "CH422G EXIO5 (USB_SEL) level that routes GPIO19/20 to the USB-OTG connector"
        range 0 1
        default 0
        help
            The Waveshare board multiplexes USB and CAN on GPIO19/20 through EXIO5 of the CH422G
            expander. If the webcam never enumerates, flip this value.

    config DT_SCAN_MAX_FPS
        int "Max card frames uploaded per second during scan"
        default 3

    config DT_OFFLINE_QUEUE_MAX
        int "Max events held in the offline queue"
        default 300

endmenu
```

## firmware/sdkconfig.defaults
```kconfig
# ---------- Chip / memory (ESP32-S3-WROOM-1-N8R8) ----------
CONFIG_IDF_TARGET="esp32s3"
CONFIG_ESPTOOLPY_FLASHSIZE_8MB=y
CONFIG_ESPTOOLPY_FLASHMODE_QIO=y
CONFIG_ESPTOOLPY_FLASHFREQ_80M=y
CONFIG_PARTITION_TABLE_CUSTOM=y
CONFIG_PARTITION_TABLE_CUSTOM_FILENAME="partitions.csv"
CONFIG_ESP_DEFAULT_CPU_FREQ_MHZ_240=y
CONFIG_SPIRAM=y
CONFIG_SPIRAM_MODE_OCT=y
CONFIG_SPIRAM_SPEED_80M=y
CONFIG_SPIRAM_USE_MALLOC=y
CONFIG_SPIRAM_MALLOC_ALWAYSINTERNAL=4096
CONFIG_SPIRAM_MALLOC_RESERVE_INTERNAL=65536
# Keep the RGB panel stable while flash is busy (Wi-Fi / NVS writes)
CONFIG_SPIRAM_FETCH_INSTRUCTIONS=y
CONFIG_SPIRAM_RODATA=y
CONFIG_LCD_RGB_RESTART_IN_VSYNC=y
CONFIG_LCD_RGB_ISR_IRAM_SAFE=y
CONFIG_ESP32S3_DATA_CACHE_LINE_64B=y
CONFIG_COMPILER_OPTIMIZATION_PERF=y
CONFIG_FREERTOS_HZ=1000
CONFIG_ESP_MAIN_TASK_STACK_SIZE=8192
CONFIG_ESP_TASK_WDT_TIMEOUT_S=10

# ---------- Networking / TLS ----------
CONFIG_LWIP_SNTP_MAX_SERVERS=3
CONFIG_LWIP_DHCP_GET_NTP_SRV=n
CONFIG_ESP_WIFI_STATIC_RX_BUFFER_NUM=10
CONFIG_ESP_WIFI_DYNAMIC_RX_BUFFER_NUM=32
CONFIG_SPIRAM_TRY_ALLOCATE_WIFI_LWIP=y
CONFIG_MBEDTLS_CERTIFICATE_BUNDLE=y
CONFIG_MBEDTLS_CERTIFICATE_BUNDLE_DEFAULT_FULL=y
CONFIG_MBEDTLS_EXTERNAL_MEM_ALLOC=y
CONFIG_MBEDTLS_DYNAMIC_BUFFER=y
CONFIG_ESP_TLS_INSECURE=n
CONFIG_ESP_HTTP_CLIENT_ENABLE_HTTPS=y

# ---------- USB host (UVC webcam on the OTG port) ----------
CONFIG_USB_HOST_CONTROL_TRANSFER_MAX_SIZE=2048
CONFIG_USB_HOST_HW_BUFFER_BIAS_PERIODIC_OUT=n
CONFIG_USB_HOST_HW_BUFFER_BIAS_BALANCED=y

# ---------- LVGL 8.3 ----------
CONFIG_LV_COLOR_DEPTH_16=y
CONFIG_LV_COLOR_16_SWAP=n
CONFIG_LV_MEM_CUSTOM=y
CONFIG_LV_MEMCPY_MEMSET_STD=y
CONFIG_LV_DISP_DEF_REFR_PERIOD=16
CONFIG_LV_INDEV_DEF_READ_PERIOD=20
CONFIG_LV_TICK_CUSTOM=n
CONFIG_LV_ATTRIBUTE_FAST_MEM_USE_IRAM=y
CONFIG_LV_FONT_MONTSERRAT_16=y
CONFIG_LV_FONT_MONTSERRAT_20=y
CONFIG_LV_FONT_MONTSERRAT_24=y
CONFIG_LV_FONT_MONTSERRAT_28=y
CONFIG_LV_FONT_MONTSERRAT_40=y
CONFIG_LV_FONT_MONTSERRAT_48=y
CONFIG_LV_FONT_DEFAULT_MONTSERRAT_20=y
CONFIG_LV_USE_QRCODE=y
CONFIG_LV_USE_KEYBOARD=y
CONFIG_LV_USE_CANVAS=y
CONFIG_LV_USE_PERF_MONITOR=n
CONFIG_LV_USE_LOG=n
CONFIG_LV_USE_ASSERT_NULL=y
CONFIG_LV_USE_ASSERT_MALLOC=y

# ---------- App ----------
CONFIG_DT_CAMERA_UVC=y
```
